## conf/layer.conf
```bitbake
# We have a conf and classes directory, add to BBPATH
BBPATH .= ":${LAYERDIR}"

# We have recipes-* directories, add to BBFILES
BBFILES += "${LAYERDIR}/recipes-*/*/*.bb ${LAYERDIR}/recipes-*/*/*.bbappend ${LAYERDIR}/images/*.bb"

BBFILE_COLLECTIONS += "qt5-eglfs"

BBFILE_PATTERN_qt5-eglfs = "^${LAYERDIR}/"
BBFILE_PRIORITY_qt5-eglfs = "16"

FSL_EULA_FILE = "${LAYERDIR}/EULA"
FSL_MIRROR ?= "http://www.freescale.com/lgfiles/NMG/MAD/YOCTO/"

LAYERSERIES_COMPAT_qt5-eglfs = "zeus"
```
